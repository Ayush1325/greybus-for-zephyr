## CMakeLists.txt
```
# SPDX-License-Identifier: BSD-3-Clause

cmake_minimum_required(VERSION 3.20.0)

find_package(Zephyr REQUIRED HINTS $ENV{ZEPHYR_BASE})

project(greybus-net)

target_sources(app PRIVATE src/main.c)
```

## prj.conf
```kconfig
# Greybus options and dependencies
CONFIG_GREYBUS=y

# Generic networking options
CONFIG_NETWORKING=y
CONFIG_NET_UDP=y
CONFIG_NET_TCP=y
CONFIG_NET_IPV6=y
CONFIG_NET_IPV4=y
CONFIG_NET_SOCKETS=y
CONFIG_NET_SOCKETS_POLL_MAX=16
CONFIG_ZVFS_OPEN_MAX=16
CONFIG_NET_CONNECTION_MANAGER=y
CONFIG_NET_MAX_CONN=16

# Service advertisement options
CONFIG_DNS_SD=y
CONFIG_NET_HOSTNAME_ENABLE=y
CONFIG_MDNS_RESPONDER=y
CONFIG_MDNS_RESPONDER_DNS_SD=y

# Kernel options
CONFIG_MAIN_STACK_SIZE=1024
CONFIG_ENTROPY_GENERATOR=y
CONFIG_INIT_STACKS=y

# Logging
CONFIG_LOG=y

# Network buffers
CONFIG_NET_PKT_RX_COUNT=64
CONFIG_NET_PKT_TX_COUNT=32
CONFIG_NET_BUF_RX_COUNT=64
CONFIG_NET_BUF_TX_COUNT=32
CONFIG_NET_CONTEXT_NET_PKT_POOL=y

# IP address options
CONFIG_NET_IF_UNICAST_IPV6_ADDR_COUNT=3
CONFIG_NET_IF_MCAST_IPV6_ADDR_COUNT=4
CONFIG_NET_MAX_CONTEXTS=16

# Network application options and configuration
CONFIG_NET_CONFIG_SETTINGS=y
CONFIG_NET_CONFIG_MY_IPV6_ADDR="2001:db8::1"
CONFIG_NET_CONFIG_PEER_IPV6_ADDR="2001:db8::2"
CONFIG_NET_CONFIG_MY_IPV4_ADDR="192.0.2.1"
CONFIG_NET_CONFIG_PEER_IPV4_ADDR="192.0.2.2"
```

## overlay-802154-subg.conf
```kconfig
CONFIG_BT=n

# Disable TCP and IPv4 (TCP disabled to avoid heavy traffic)
CONFIG_NET_TCP=y
CONFIG_NET_IPV4=n

CONFIG_NET_CONFIG_NEED_IPV6=y
CONFIG_NET_CONFIG_NEED_IPV4=n
CONFIG_NET_CONFIG_MY_IPV4_ADDR=""
CONFIG_NET_CONFIG_PEER_IPV4_ADDR=""

CONFIG_NET_L2_IEEE802154=y

CONFIG_IEEE802154_CC13XX_CC26XX=n
CONFIG_NET_CONFIG_IEEE802154_CHANNEL=1
CONFIG_IEEE802154_CC13XX_CC26XX_SUB_GHZ=y
CONFIG_IEEE802154_CC13XX_CC26XX_SUB_GHZ_NUM_RX_BUF=8
```

## boards/beagleconnect_freedom.conf
```kconfig
CONFIG_GPIO=y
CONFIG_GREYBUS_GPIO=y
CONFIG_GPIO_GET_DIRECTION=y

CONFIG_I2C=y
CONFIG_GREYBUS_I2C=y

CONFIG_GREYBUS_LOOPBACK=y

CONFIG_LED=y
CONFIG_GREYBUS_LIGHTS=y

CONFIG_OPT3001=n
CONFIG_LIS2DH=n
CONFIG_LIS2DH_OPER_MODE_LOW_POWER=n
CONFIG_TI_HDC20XX=n
```

## boards/beagleconnect_freedom.overlay
```dts
/*
 * Copyright (c) 2020 Friedt Professional Engineering Services, Inc
 * Copyright (c) 2025 Ayush Singh BeagleBoard.org
 *
 * SPDX-License-Identifier: BSD-3-Clause
 */

/ {
	zephyr,greybus {
		gbbundle1 {
			status = "okay";
			compatible = "zephyr,greybus-bundle-bridged-phy";
			gpio-controllers = <&gpio0>;
			i2c-controllers = <&sens_i2c>;
		};
	};
};
```

## src/main.c
```c
/*
 * Copyright (c) 2109 Friedt Professional Engineering Services, Inc
 *
 * SPDX-License-Identifier: BSD-3-Clause
 */

#include <stdio.h>
#include <zephyr/kernel.h>

int main(void)
{
	return 0;
}
```
