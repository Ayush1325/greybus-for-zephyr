## CMakeLists.txt
```
# SPDX-License-Identifier: BSD-3-Clause

cmake_minimum_required(VERSION 3.13.1)
find_package(Zephyr)
project(greybus-net)

target_sources(app PRIVATE src/main.c)
```

## prj.conf
```kconfig
CONFIG_GREYBUS=y
CONFIG_GREYBUS_XPORT_DUMMY=y
CONFIG_GREYBUS_SPI=n
```

## boards/beagleconnect_freedom.conf
```kconfig
CONFIG_GPIO=y
CONFIG_GPIO_GET_DIRECTION=y
CONFIG_GREYBUS_GPIO=y

CONFIG_I2C=y
CONFIG_GREYBUS_I2C=y

CONFIG_GREYBUS_LOOPBACK=y

CONFIG_LED=y
CONFIG_GREYBUS_LIGHTS=y

CONFIG_OPT3001=n
CONFIG_LIS2DH=n
CONFIG_LIS2DH_OPER_MODE_LOW_POWER=n
CONFIG_TI_HDC20XX=n
```

## boards/beagleconnect_freedom.overlay
```dts
/*
 * Copyright (c) 2020 Friedt Professional Engineering Services, Inc
 * Copyright (c) 2025 Ayush Singh BeagleBoard.org
 *
 * SPDX-License-Identifier: BSD-3-Clause
 */

/ {
	zephyr,greybus {
		gbbundle1 {
			status = "okay";
			compatible = "zephyr,greybus-bundle-bridged-phy";
			gpio-controllers = <&gpio0>;
			i2c-controllers = <&sens_i2c>;
		};

		gbbundle2 {
			status = "okay";
			compatible = "zephyr,greybus-bundle-lights";
			lights = <&leds>;
		};
	};
};
```

## src/main.c
```c
/*
 * Copyright (c) 2025 Ayush Singh BeagleBoard.org
 *
 * SPDX-License-Identifier: BSD-3-Clause
 */

#include <zephyr/sys/printk.h>
#include "greybus-utils/manifest.h"

static char manifest[1024];

int main(void)
{
	int ret = manifest_create(manifest, ARRAY_SIZE(manifest));

	printk("Manifest Size: %d\n", ret);
	manifest_print(manifest);

	return 0;
}
```
