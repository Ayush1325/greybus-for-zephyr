## drivers/audio/Kconfig
```kconfig
config FAKE_AUDIO
	bool "Fake Audio Driver"
	default n
	help
	  Enable the fake audio driver for simulation testing
```

## dts/bindings/greybus/zephyr,greybus-bundle-audio.yaml
```yaml
# Copyright (c) 2026, Pavithra CP BeagleBoard.org
# SPDX-License-Identifier: Apache-2.0

description: Greybus Bundle for Audio class

compatible: "zephyr,greybus-bundle-audio"

include: [base.yaml]

properties:
  audios:
    type: phandles
    description: Audio devices in the bundle
```
