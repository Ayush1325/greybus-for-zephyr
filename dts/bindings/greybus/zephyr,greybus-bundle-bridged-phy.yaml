## dts/bindings/greybus/zephyr,greybus-bundle-bridged-phy.yaml
```yaml
# Copyright (c) 2025, Ayush Singh BeagleBoard.org
# SPDX-License-Identifier: Apache-2.0

description: Greybus Bundle for class Bridged PHY

compatible: "zephyr,greybus-bundle-bridged-phy"

include: [base.yaml]

properties:
  gpio-controllers:
    type: phandles
    description: GPIO controllers in the bundle

  i2c-controllers:
    type: phandles
    description: I2C controllers in the bundle
```

## dts/bindings/greybus/zephyr,greybus.yaml
```yaml
# Copyright (c) 2020, Friedt Professional Engineering Services, Inc
# SPDX-License-Identifier: BSD-3-Clause

# Common fields for GPIO controllers

description: Greybus

compatible: "zephyr,greybus"

include: [base.yaml]

properties:
    "greybus":
      type: boolean
      required: true
      description: Foo
    "#address-cells":
      type: int
      required: false
      default: 1
      const: 1
    "#size-cells":
      type: int
      required: false
      default: 0
      const: 0
```

## west.yml
```yaml
# Copyright (c) 2024 Ayush Singh <ayush@beagleboard.org>
# SPDX-License-Identifier: Apache-2.0

manifest:
  self:
    west-commands: scripts/west-commands.yml

  remotes:
    - name: ayush
      url-base: https://openbeagle.org/ayush1325

  projects:
    - name: zephyr
      remote: ayush
      revision: bct-2
      import:
        name-allowlist:
          - hal_ti
          - cmsis
```
